/ {
    totem_physical_layout {
        compatible = "zmk,physical-layout";
        keys = <
            0 1 2 3 4 5 6 7 8 9
            10 11 12 13 14 15 16 17 18 19
            20 21 22 23 24 25 26 27 28 29
            30 31 32 33 34 35 36 37 38 39
        >;
        key-positions = <
            0   0    // key 0
            18  0    // key 1
            36  0    // key 2
            54  0    // key 3
            72  0    // key 4
            90  0    // key 5
            108 0    // key 6
            126 0    // key 7
            144 0    // key 8
            162 0    // key 9
            0   18   // key 10
            18  18   // key 11
            36  18   // key 12
            54  18   // key 13
            72  18   // key 14
            90  18   // key 15
            108 18   // key 16
            126 18   // key 17
            144 18   // key 18
            162 18   // key 19
            0   36   // key 20
            18  36   // key 21
            36  36   // key 22
            54  36   // key 23
            72  36   // key 24
            90  36   // key 25
            108 36   // key 26
            126 36   // key 27
            144 36   // key 28
            162 36   // key 29
            0   54   // key 30
            18  54   // key 31
            36  54   // key 32
            54  54   // key 33
            72  54   // key 34
            90  54   // key 35
            108 54   // key 36
            126 54   // key 37
            144 54   // key 38
            162 54   // key 39
        >;
    };
};
